#include <physical_layouts.dtsi>

// ============================================================
// STEP 3 of 5 — Physical key layout (used by ZMK Studio)
// ============================================================

/ {
    physical_layout0: physical_layout_0 {
        compatible = "zmk,physical-layout";
        display-name = "Default";

        transform = <&default_transform>;

        keys  //                     w   h    x    y     rot    rx    ry
            // STEP 3: Paste your keyboard's key_physical_attrs lines here.
            // Each line except the last ends with a comma.
            // The MacroKnob lines below already start with ',' so your
            // last keyboard line does NOT need a trailing comma.
            //
            // If your keyboard has no physical layout defined, you can
            // generate one from its info.json using the ZMK physical
            // layout generator, or leave this section empty and skip Studio.

            // Below are the key attributes for the MacroKnob.
            // Adjust x/y if they overlap with your keyboard in Studio.
            //                       w   h    x    y     rot    rx    ry
            = <&key_physical_attrs 100 100  775    0       0     0     0>   // Knob key
            , <&key_physical_attrs 100 100  725  150       0     0     0>   // Left
            , <&key_physical_attrs 100 100  825  150       0     0     0>   // Right
            ;
    };
};
