## boards/shields/macroknob/Kconfig.defconfig
```kconfig
# Copyright (c) 2022 The ZMK Contributors
# SPDX-License-Identifier: MIT

# ============================================================
# STEP 1 applied — Aurora Sofle example
# ============================================================

if SHIELD_MACROKNOB

# (STEP 1a applied — "Macroknob Sofle": left + right Sofle halves dongle)
config ZMK_KEYBOARD_NAME
    default "Macroknob Sofle"

config ZMK_SPLIT
    default y

config ZMK_SPLIT_ROLE_CENTRAL
    default y

# (STEP 1b applied — 2 peripherals: left + right Aurora Sofle halves)
config ZMK_SPLIT_BLE_CENTRAL_PERIPHERALS
    default 2

# (STEP 1c applied — 2 peripherals + 5 host profiles = 7)
config BT_MAX_CONN
    default 7

# (STEP 1d applied — equal to BT_MAX_CONN)
config BT_MAX_PAIRED
    default 7

endif # SHIELD_MACROKNOB
```

## boards/shields/macroknob/Kconfig.shield
```kconfig
# Copyright (c) 2022 The ZMK Contributors
# SPDX-License-Identifier: MIT

config SHIELD_MACROKNOB_DONGLE
    def_bool $(shields_list_contains,macroknob_dongle)

config SHIELD_SPLITKB_AURORA_LILY58_LEFT
    def_bool $(shields_list_contains,macroknob_lily58_left)

config SHIELD_SPLITKB_AURORA_LILY58_RIGHT
    def_bool $(shields_list_contains,macroknob_lily58_right)
```
