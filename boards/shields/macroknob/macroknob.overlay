#include <dt-bindings/zmk/matrix_transform.h>
#include "macroknob.dtsi"

/ {
    chosen {
        zmk,kscan = &kscan0;
    };

    kscan0: kscan0 {
        compatible = "zmk,kscan-gpio-direct";
        wakeup-source;
        input-gpios
            = <&pro_micro 10 (GPIO_ACTIVE_LOW | GPIO_PULL_UP) >
            , <&pro_micro 9  (GPIO_ACTIVE_LOW | GPIO_PULL_UP) >
            , <&pro_micro 14 (GPIO_ACTIVE_LOW | GPIO_PULL_UP) >
            ;
    };

};

// ============================================================
// STEP 5 applied — Aurora Sofle example
// ============================================================
&default_transform {
    // (STEP 5 applied — Aurora Sofle has 5 keyboard rows, so row-offset = 5)
    row-offset = <5>;   // Aurora Sofle rows (6) - 1
};
